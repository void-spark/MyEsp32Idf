## sdkconfig.defaults
```kconfig
# My configuration options
CONFIG_ESPTOOLPY_PORT="rfc2217://host.docker.internal:2217"
CONFIG_ESPTOOLPY_BAUD_921600B=y

# My chips are 4MB flash, once you use OTA this settings matters
CONFIG_ESPTOOLPY_FLASHSIZE_4MB=y

# Set up partitions for OTA
CONFIG_PARTITION_TABLE_CUSTOM=y

# Yes we know what we're doing and want plain HTTP
CONFIG_OTA_ALLOW_HTTP=y

# All the speed for WS8212, RF handling, etc.
CONFIG_ESP32_DEFAULT_CPU_FREQ_240=y
CONFIG_FREERTOS_HZ=1000

# Disable fancy MQTT things we don't want
CONFIG_MQTT_TRANSPORT_SSL=
CONFIG_MQTT_TRANSPORT_WEBSOCKET=

# Pin MQTT task to the system core, just in case
CONFIG_MQTT_TASK_CORE_SELECTION_ENABLED=y
CONFIG_MQTT_USE_CORE_0=y

#CONFIG_LOG_DEFAULT_LEVEL_DEBUG=y

CONFIG_I2S_SUPPRESS_DEPRECATE_WARN=y
```
